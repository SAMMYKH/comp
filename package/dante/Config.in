## package/dante/Config.in
```kconfig
config BR2_PACKAGE_DANTE
	bool "dante"
	depends on BR2_PACKAGE_HAS_LIBEGL
	depends on BR2_PACKAGE_XORG7
	select BR2_PACKAGE_LIBCURL
	select BR2_PACKAGE_LIBOPENAL
	select BR2_PACKAGE_JPEG
	select BR2_PACKAGE_LIBVORBIS
	help
	  Doom 3 OPENGL ES2.0 port.

	  https://github.com/omcfadde/dante/tree/es2
```

## package/gstreamer/gst-python/Config.in
```kconfig
config BR2_PACKAGE_GST_PYTHON
	bool "gst-python"
    depends on BR2_PACKAGE_PYTHON
    depends on BR2_PACKAGE_GSTREAMER
    depends on BR2_PACKAGE_PYGTK
	help
	  Adds Python GStreamer bindings.
      
	  http://gstreamer.freedesktop.org/modules/gst-python.html
```

## package/imageserver/Config.in
```kconfig
config BR2_PACKAGE_IMAGESERVER
	bool "imageserver"
	select BR2_PACKAGE_CAIRO
	select BR2_PACKAGE_LIBMICROHTTPD
	help
	  Simple HTTP image upload server for displaying PNGs on a framebuffer.

	  https://git.axent.com.au/ag14003/imageserver
```

## package/libjsoncpp/Config.in
```kconfig
config BR2_PACKAGE_LIBJSONCPP
	bool "libjsoncpp"
	help
	  A C++ JSON library.

	  https://github.com/open-source-parsers/jsoncpp

comment "libjsonrpc-cpp needs a toolchain w/ C++"
	depends on !BR2_INSTALL_LIBSTDCPP
```

## package/libjsonrpc-cpp/Config.in
```kconfig
config BR2_PACKAGE_LIBJSONRPC_CPP
	bool "libjsonrpc-cpp"
	select BR2_PACKAGE_LIBMICROHTTPD
	select BR2_PACKAGE_LIBJSONCPP
	select BR2_PACKAGE_LIBCURL
	select BR2_PACKAGE_LIBPTHREAD_STUBS
	help
	  A C++ JSON-RPC 2.0 library.

	  https://github.com/cinemast/libjson-rpc-cpp

comment "libjsonrpc-cpp needs a toolchain w/ C++"
	depends on !BR2_INSTALL_LIBSTDCPP

comment "libjsonrpc-cpp needs a toolchain w/ threads"
	depends on !BR2_TOOLCHAIN_HAS_THREADS
```

## package/libopenal/Config.in
```kconfig
config BR2_PACKAGE_LIBOPENAL
	bool "libopenal"
	help
	  OpenAL is a cross-platform 3D audio API appropriate
	  for use with gaming applications and many other types
	  of audio applications

	  http://connect.creativelabs.com/openal/default.aspx
```

## package/libxbee/Config.in
```kconfig
config BR2_PACKAGE_LIBXBEE
	bool "libxbee"
	help
	  libxbee is a C/C++ library to aid the use
	  of Digi XBee radios running in API mode.

	  http://attie.co.uk/libxbee
```

## package/mrwa-xbee-comms/Config.in
```kconfig
config BR2_PACKAGE_MRWA_XBEE_COMMS
	bool "mrwa-xbee-comms"
	depends on BR2_PACKAGE_LIBXBEE && BR2_PACKAGE_SQLITE && BR2_PACKAGE_ZLIB && BR2_PACKAGE_OPENSSL
	depends on BR2_TOOLCHAIN_HAS_THREADS
	help
	  mrwa-xbee-comms is an XBee comms daemon written in C.

	  https://git.axent.com.au/mrwa/mrwa_xbee_comms
```

## package/npreal/Config.in
```kconfig
config BR2_PACKAGE_NPREAL
	bool "npreal"
	help
	  Moxa real tty serial drivers.

	  https://git.axent.com.au/ag13008/npreal
```

## package/pil/Config.in
```kconfig
config BR2_PACKAGE_PIL
	bool "pil"
    depends on BR2_PACKAGE_PYTHON
	help
	  Adds support for opening, manipulating, and saving
	  different image file formats to Python.
      
	  http://www.pythonware.com/products/pil/
```

## package/proftpd/Config.in
```kconfig
config BR2_PACKAGE_PROFTPD
	bool "proftpd"
	depends on BR2_USE_MMU # fork()
	help
	  ProFTPD, a highly configurable FTP server.

	  http://www.proftpd.org/
	  
	#
	# Configuration selection
	#

	choice
		prompt "ProFTPD configuration"
		default BR2_PACKAGE_PROFTPD_USE_DEFAULT

	config BR2_PACKAGE_PROFTPD_USE_DEFAULT
		bool "Using default configuration"

	config BR2_PACKAGE_PROFTPD_USE_CUSTOM_CONFIG
		bool "Using a custom config file"

	endchoice

	config BR2_PACKAGE_PROFTPD_CUSTOM_CONFIG_FILE
		string "Configuration file path"
		depends on BR2_PACKAGE_PROFTPD_USE_CUSTOM_CONFIG
		help
		  Path to the proftpd configuration file

if BR2_PACKAGE_PROFTPD

config BR2_PACKAGE_PROFTPD_MOD_REWRITE
	bool "mod_rewrite support"
	help
	  Compile ProFTPD with mod_rewrite support

endif
```

## package/pycairo/Config.in
```kconfig
config BR2_PACKAGE_PYCAIRO
	bool "pycairo"
    depends on BR2_PACKAGE_PYTHON && BR2_PACKAGE_CAIRO
	help
	  Adds Python bindings for the Cairo graphics
	  library.
      
	  http://cairographics.org/pycairo/
```

## package/pygobject/Config.in
```kconfig
config BR2_PACKAGE_PYGOBJECT
	bool "pygobject"
    depends on BR2_PACKAGE_PYTHON
    depends on BR2_PACKAGE_LIBGLIB2
	help
	  Adds Python gobject introspection bindings.
      
	  http://live.gnome.org/PyGObject
```

## package/pygtk/Config.in
```kconfig
config BR2_PACKAGE_PYGTK
	bool "pygtk"
	select BR2_PACKAGE_PYGOBJECT
    depends on BR2_PACKAGE_PYTHON
    depends on BR2_PACKAGE_LIBGLIB2
    depends on BR2_PACKAGE_LIBGTK2
	help
	  Adds Python GTK2+ bindings.
      
	  http://live.gnome.org/PyGTK
```

## package/python-bitstring/Config.in
```kconfig
config BR2_PACKAGE_PYTHON_BITSTRING
	bool "python-bitstring"
	depends on BR2_PACKAGE_PYTHON
	help
	  python-bitstring is a Python library to give support for bitstrings.

	  http://packages.python.org/bitstring
```

## package/python-dateutil/Config.in
```kconfig
config BR2_PACKAGE_PYTHON_DATEUTIL
	bool "python-dateutil"
	depends on BR2_PACKAGE_PYTHON
	help
	  python-dateutil is a Python library which provides advanced
	  date and time handling features.

	  http://http://labix.org/python-dateutil
```

## package/python-evdev/Config.in
```kconfig
config BR2_PACKAGE_PYTHON_EVDEV
	bool "python-evdev"
	depends on BR2_PACKAGE_PYTHON
	help
	  This package provides bindings to the generic input event interface in Linux.

	  https://pypi.python.org/pypi/evdev
```

## package/python-pymodbus/Config.in
```kconfig
config BR2_PACKAGE_PYTHON_PYMODBUS
	bool "python-pymodbus"
	depends on BR2_PACKAGE_PYTHON
	select BR2_PACKAGE_PYTHON_PYASN
	select BR2_PACKAGE_PYTHON_PYCRYPTO
	select BR2_PACKAGE_PYTHON_TWISTED
	select BR2_PACKAGE_PYTHON_ZOPE_INTERFACE
	select BR2_PACKAGE_PYTHON_WSGIREF
	help
	  A full modbus protocol written in Python.

	  https://github.com/bashwork/pymodbus
```

## package/python-twisted/Config.in
```kconfig
config BR2_PACKAGE_PYTHON_TWISTED
	bool "python-twisted"
	depends on BR2_PACKAGE_PYTHON
	help
	  Twisted is an event-driven networking engine for Python.

	  https://pypi.python.org/pypi/Twisted
```

## package/python-wsgiref/Config.in
```kconfig
config BR2_PACKAGE_PYTHON_WSGIREF
	bool "python-wsgiref"
	depends on BR2_PACKAGE_PYTHON
	help
	  WSGI (PEP 333) Reference Library.

	  https://pypi.python.org/pypi/wsgiref
```

## package/python-zope-interface/Config.in
```kconfig
config BR2_PACKAGE_PYTHON_ZOPE_INTERFACE
	bool "python-zope-interface"
	depends on BR2_PACKAGE_PYTHON
	help
	  Interfaces for Python.

	  https://pypi.python.org/pypi/zope.interface/4.1.0
```

## package/quake3/Config.in
```kconfig
config BR2_PACKAGE_QUAKE3
	bool "quake3"
	depends on BR2_PACKAGE_HAS_LIBEGL
	depends on BR2_PACKAGE_XORG7
	select BR2_PACKAGE_LIBCURL
	select BR2_PACKAGE_LIBOPENAL
	select BR2_PACKAGE_JPEG
	select BR2_PACKAGE_LIBVORBIS
	help
	  Quake 3 OPENGL ES2.0 port.

	  https://github.com/raspberrypi/quake3
```

## package/socketcan-tools/Config.in
```kconfig
config BR2_PACKAGE_SOCKETCAN_TOOLS
	bool "socketcan-tools"
	help
	This package contains SocketCAN userspace tools.

	http://developer.berlios.de/projects/socketcan/
```

## package/x11r7/xdriver_xf86-video-imx-viv/Config.in
```kconfig
config BR2_PACKAGE_XDRIVER_XF86_VIDEO_IMX_VIV
	bool "xf86-video-imx-viv"
	select BR2_PACKAGE_XPROTO_FONTSPROTO
	select BR2_PACKAGE_XPROTO_RANDRPROTO
	select BR2_PACKAGE_XPROTO_RENDERPROTO
	select BR2_PACKAGE_XPROTO_VIDEOPROTO
	select BR2_PACKAGE_XPROTO_XPROTO
	help
	  video driver for i.MX6 Vivante GC2000
```
